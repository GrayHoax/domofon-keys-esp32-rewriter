## main/Kconfig.projbuild
```kconfig
menu "RW1990 Programmer"

    menu "Hardware"

        config RW_ONEWIRE_GPIO
            int "1-Wire data GPIO"
            range 0 48
            default 1 if IDF_TARGET_ESP32C3
            default 4
            help
                GPIO connected to the iButton contact pad. Requires an external
                2.2k..4.7k pull-up to 3.3 V. Prefer an ADC1-capable pin so the
                same line can be sensed for Cyfral/Metakom keys (ESP32-C3:
                GPIO0..4, ESP32-C6: GPIO0..6). Avoid strapping pins (ESP32-C3:
                GPIO2/8/9, ESP32-C6: GPIO4/5/8/9/15) and UART0 pins.

        config RW_ANALOG_SENSE_GPIO
            int "ADC GPIO sensing the key line for Cyfral/Metakom (-1 = off)"
            range -1 48
            default 1 if IDF_TARGET_ESP32C3
            default 4 if IDF_TARGET_ESP32C6
            default -1
            help
                Cyfral and Metakom keys (and TM01A blanks finalised as such)
                stream their code by modulating the current on the data line.
                Reading them needs an ADC1-capable pin that sees that line:
                normally the 1-Wire data pin itself (defaults: ESP32-C3 GPIO1 =
                ADC1_CH1, ESP32-C6 GPIO4 = ADC1_CH4), or a separate pin bridged
                to it when the data pin has no ADC. ADC2 pins do not work with
                Wi-Fi.

        config RW_KEY_POLL_INTERVAL_MS
            int "Reader poll interval (ms)"
            range 50 5000
            default 300
            help
                How often the background task probes the contact pad for a key.

        config RW_STATUS_LED_ENABLE
            bool "Enable status LED"
            default y

        choice RW_STATUS_LED_TYPE
            prompt "Status LED type"
            depends on RW_STATUS_LED_ENABLE
            default RW_STATUS_LED_RGB_GPIO if IDF_TARGET_ESP32C3
            default RW_STATUS_LED_WS2812
            help
                NodeMCU ESP-C3-12F-Kit carries a discrete RGB LED on three GPIOs;
                ESP32-C6 dev kits carry an addressable WS2812 on a single GPIO.

            config RW_STATUS_LED_RGB_GPIO
                bool "Discrete RGB LED on three GPIOs (LEDC PWM)"

            config RW_STATUS_LED_WS2812
                bool "Addressable WS2812 LED (RMT)"
        endchoice

        config RW_STATUS_LED_GPIO
            int "WS2812 data GPIO"
            depends on RW_STATUS_LED_WS2812
            range 0 48
            default 8
            help
                ESP32-C6-DevKitC-1 and DevKitM-1 have the on-board RGB LED on GPIO8.

        config RW_STATUS_LED_R_GPIO
            int "Red channel GPIO"
            depends on RW_STATUS_LED_RGB_GPIO
            range 0 48
            default 3

        config RW_STATUS_LED_G_GPIO
            int "Green channel GPIO"
            depends on RW_STATUS_LED_RGB_GPIO
            range 0 48
            default 4

        config RW_STATUS_LED_B_GPIO
            int "Blue channel GPIO"
            depends on RW_STATUS_LED_RGB_GPIO
            range 0 48
            default 5

        config RW_STATUS_LED_ACTIVE_LOW
            bool "RGB LED is active-low (common anode)"
            depends on RW_STATUS_LED_RGB_GPIO
            default n
            help
                ESP-C3-12F-Kit drives its LED with a high level (common cathode).
                Enable for boards where the LED lights when the pin is pulled low.

    endmenu

    menu "Network"

        config RW_AP_SSID_PREFIX
            string "Access point SSID prefix"
            default "RW1990"
            help
                The AP name is "<prefix>-XXXXXX" where XXXXXX are the last three
                bytes of the MAC address, unless overridden from the web UI.

        config RW_AP_PASSWORD
            string "Default access point password"
            default "rw1990pass"
            help
                WPA2 password for the fallback access point (8..63 characters).
                Leave empty for an open network. Can be changed from the web UI.

        config RW_STA_CONNECT_TIMEOUT_S
            int "Station connect timeout (s)"
            range 5 300
            default 30
            help
                If the configured network yields no IP address within this time
                (at boot or after an established link drops), the device raises
                its own access point and keeps retrying in the background.

        config RW_STA_RETRY_INTERVAL_S
            int "Station retry interval while in AP fallback (s)"
            range 10 3600
            default 60

        config RW_AP_LINGER_S
            int "Keep AP alive after station connects (s)"
            range 0 600
            default 15
            help
                Gives an operator connected to the AP time to read the new
                station IP address before the AP shuts down.

        config RW_MDNS_HOSTNAME
            string "mDNS hostname"
            default "rw1990"
            help
                The UI is reachable at http://<hostname>.local

        config RW_HTTP_PORT
            int "HTTP server port"
            range 1 65535
            default 80

    endmenu

endmenu
```
